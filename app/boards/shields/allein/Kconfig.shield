## app/boards/shields/allein/Kconfig.shield
```kconfig
# Copyright (c) 2020 Pete Johanson
# SPDX-License-Identifier: MIT

config SHIELD_ALLEIN_LEFT
    def_bool $(shields_list_contains,allein_left)

config SHIELD_ALLEIN_RIGHT
    def_bool $(shields_list_contains,allein_right)
```

## app/boards/shields/allein_compact/Kconfig.shield
```kconfig
# Copyright (c) 2020 Pete Johanson
# SPDX-License-Identifier: MIT


config SHIELD_ALLEINCOMPACT
    def_bool $(shields_list_contains,allein_compact)
```

## app/boards/shields/alleindrach/Kconfig.defconfig
```kconfig
# Central Side Configuration
#
# The side on which the PS/2 mouse is connected MUST be the central side.
#
# By default zmk configures the LEFT side as the central side. But most people
# want to connect their pointing devices to the RIGHT side.
#
# So, you need to define that the central side is the one to which the
# pointing device is connected to.
if SHIELD_ALLEINDRACH

config ZMK_KEYBOARD_NAME
    default "alleindrach-tp"


endif
# Options that should be enabled on both sides
if SHIELD_ALLEIN_LEFT || SHIELD_ALLEIN_RIGHT

config ZMK_SPLIT
    default y

if ZMK_DISPLAY

config I2C
    default y

config SSD1306
    default y

endif # ZMK_DISPLAY

if LVGL

config LV_Z_VDB_SIZE
    default 64

config LV_DPI_DEF
    default 148

config LV_Z_BITS_PER_PIXEL
    default 1

choice LV_COLOR_DEPTH
    default LV_COLOR_DEPTH_1
endchoice

endif # LVGL

endif


menuconfig ZMK_RGB_INDICATORS
    bool "RGB Adressable LED Indicators"
    select LED_STRIP
    select ZMK_LOW_PRIORITY_WORK_QUEUE

if ZMK_RGB_INDICATORS

# This default value cuts down on tons of excess .conf files, if you're using GPIO, manually disable this
config SPI
    default y

config ZMK_RGB_INDICATORS_EXT_POWER
    bool "RGB underglow toggling also controls external power"
    default y

config ZMK_RGB_INDICATORS_BRT
    int "RGB underglow minimum brightness in percent"
    default 10


config ZMK_RGB_INDICATORS_HUE
    int "RGB underglow start hue value in degrees"
    default 100

config ZMK_RGB_INDICATORS_SAT
    int "RGB underglow start saturations value in percent"
    default 100


config ZMK_RGB_INDICATORS_EFF
    int "RGB underglow start effect int value related to the effect enum list"
    default 0

config ZMK_RGB_INDICATORS_ON_START
    bool "RGB status indicators starts on by default"
    default y

config ZMK_RGB_INDICATORS_AUTO_OFF_IDLE
    bool "Turn off RGB underglow when keyboard goes into idle state"

config ZMK_RGB_INDICATORS_AUTO_OFF_USB
    bool "Turn off RGB underglow when USB is disconnected"
    depends on USB_DEVICE_STACK

config ZMK_RGB_INDICATORS_SPD
    int "RGB underglow start animation speed value"
    default 3

#ZMK_RGB_INDICATORS
endif
menuconfig ZMK_HAS_TRACKPOINT
    bool "Has Thinkpad TrackPoint"
    default y
```

## app/dts/bindings/zmk,behavior-rgb-indicators.yaml
```yaml
# Copyright (c) 2020 The ZMK Contributors
# SPDX-License-Identifier: MIT

description: RGB Indicators Action

compatible: "zmk,behavior-rgb-indicators"

include: two_param.yaml
```

## app/dts/bindings/zmk,rgb-indicators.yaml
```yaml
# Copyright (c) 2020, The ZMK Contributors
# SPDX-License-Identifier: MIT

description: rgb indicators

compatible: "zmk,rgb-indicators"

properties:
  bat-lhs:
    type: array
    required: false
  bat-rhs:
    type: array
    required: false
  capslock:
    type: int
    required: true
  numlock:
    type: int
    required: false
  scrolllock:
    type: int
    required: false
  layer-state:
    type: int
    required: false
  ble-state:
    type: int
    required: true
  usb-state:
    type: int
    required: false
  output-fallback:
    type: int
    required: false
```

## app/west.yml
```yaml
manifest:
  remotes:
    - name: zephyrproject-rtos
      url-base: https://github.com/zephyrproject-rtos
    - name: zmkfirmware
      url-base: https://github.com/zmkfirmware
    - name: infused-kim
      url-base: https://github.com/infused-kim
    - name: alleindrach
      url-base: https://github.com/alleindrach
  projects:
    - name: zmk_ps2_mouse_trackpoint_driver
      remote: alleindrach
      path: kb_zmk_ps2_mouse_trackpoint_driver
      revision: allein.dev
    - name: zephyr
      remote: zmkfirmware
      revision: v3.5.0+zmk-fixes
      clone-depth: 1
      import:
        name-blocklist:
          - ci-tools
          - hal_altera
          - hal_cypress
          - hal_infineon
          - hal_microchip
          - hal_nxp
          - hal_openisa
          - hal_silabs
          - hal_xtensa
          - hal_st
          - hal_ti
          - loramac-node
          - mcuboot
          - mcumgr
          - net-tools
          - openthread
          - edtt
          - trusted-firmware-m


  self:
    west-commands: scripts/west-commands.yml
```
